/**
 ******************************************************   
 * @文件：exti.c
 * @作者：方宗武
 * @版本：V2.2
 * @日期：2018年7月
 * @简介：该文件提供了crc的计算功能，发送crc计算后的数据
 *    	  包，并对接收包进行crc校验。
 ********************************************************
 */
#include "crc.h"
#include "usart.h"
#include "sys.h"
#include "delay.h" 

#define keyTxDataLen 12  //发送按键的数据长度

//===================     CRC校验码表 ==========================//
const u16 crc_tab[256]=
{ 
	0x0000, 0x1021, 0x2042, 0x3063, 0x4084, 0x50a5, 0x60c6, 0x70e7,
	0x8108, 0x9129, 0xa14a, 0xb16b, 0xc18c, 0xd1ad, 0xe1ce, 0xf1ef,
	0x1231, 0x0210, 0x3273, 0x2252, 0x52b5, 0x4294, 0x72f7, 0x62d6,
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	0x6e17, 0x7e36, 0x4e55, 0x5e74, 0x2e93, 0x3eb2, 0x0ed1, 0x1ef0
};

//定义并且初始化按键发送的数据包
uint8_t keyPackage[keyTxDataLen] = {0xA3,0xA4,0xFF,0xFF,0x00,0x04,0x10,0x15,0x01,0x11,0x00,0x00};
//定义并且初始化2Y0A21红外测距模块发送的数据包。
uint8_t infraredPackage[keyTxDataLen] ={0xA3,0xA4,0xFF,0xFF,0x00,0x04,0x10,0x47,0x01,0x00,0x00,0x00};



/**
  * @功能：  对数据进行CRC计算
  * @参数1： 待计算的CRC数据的数组地址
  * @参数2： 待计算的CRC数据的数组长度
  * @返回值：返回一个u16类型的CRC校验数据
  */
u16 get_crc(u8* ptr,u8 len)
{
	u8 dat;
	u16 crc;
	u8 l;
	l=len;
	crc=0;
	while(l--!=0)
	{
		dat=(u8)(crc>>8);
		crc<<=8;
		crc^=crc_tab[dat^*ptr];
		ptr++;
	}
	return crc;
}

/* 功能： 发送按键数据进行CRC计算并打包，最后进行发送
** 参数1：传进对应的命令参数i,用于区分不同的按键值
** 返回值：无
*/
void keyPackageTxFun(u8 i)
{
		u16 crcCode;
		u8 t;
	
		keyPackage[9] = i;
		crcCode = get_crc(keyPackage,10);		//CRC总共计算按键发送数据的前十个值
		keyPackage[10] = (u8)(crcCode >> 8);
		keyPackage[11] = (u8)(crcCode);
	
		USART_ClearFlag(USART2,USART_FLAG_TC); //解决串口发送数据第一个字节丢失的问题
		for(t=0;t<keyTxDataLen;t++)
		{
			USART_SendData(USART2,keyPackage[t]);
			while(USART_GetFlagStatus(USART2,USART_FLAG_TC)!=SET);
		}
}

/* 功能： 发送按键数据进行CRC计算并打包，最后进行发送
** 参数1：传进对应的命令参数i,用来标志有人或者没有人
** 返回值：无
*/
void infraredPackageTxFun(u8 i)
{
		u16 crcCode;
		u8 t;
	
		keyPackage[9] = i;
		crcCode = get_crc(keyPackage,10);		//CRC总共计算按键发送数据的前十个值
		keyPackage[10] = (u8)(crcCode >> 8);
		keyPackage[11] = (u8)(crcCode);
	
		USART_ClearFlag(USART2,USART_FLAG_TC); //解决串口发送数据第一个字节丢失的问题
		for(t=0;t<keyTxDataLen;t++)
		{
			USART_SendData(USART2,keyPackage[t]);
			while(USART_GetFlagStatus(USART2,USART_FLAG_TC)!=SET);
		}
}

/*
** 功能：  对接收到的包进行检验
** 参数：  无
** 返回值：数据包校验出错返回-1；上位机接收成功返回1，
**		   上位机接收有误返回0；
*/
int checkRcvPackageFcn(void)
{
	u16 crc_check;
	int i;
	if(packageRcvSta == 11)			//判断接收到的数据包是否完整
	{
		if(packageRcvTemp[0]==0xA3 && packageRcvTemp[1]== 0xA4)
			if(packageRcvTemp[2]==0x00 && packageRcvTemp[3]== 0x00)
				if(packageRcvTemp[4]==0x00 && packageRcvTemp[5]== 0x03)
					if(packageRcvTemp[6]==0x10 && packageRcvTemp[7]== 0x1B)
						if(packageRcvTemp[8]<=0x57)
							{
									crc_check = get_crc(packageRcvTemp,9);
									if(packageRcvTemp[9] == (u8)crc_check && packageRcvTemp[10] == (u8)(crc_check >> 8) )
									{
										for(i=0;i<11;i++)
											packageRcv[i] = packageRcvTemp[i];	//校验成功，将接收到的数据包进行另外的保存
									}
									if(packageRcv[8] == 0x55)
											return 1;
									else if(packageRcv[8] == 0x56)
											return 0; 
									else
										return -1;		//接收到其他数据也视为数据包接收有误
   							}
		packageRcvSta = 0;	//处理完成接收后对接收状态进行恢复处理
	}
	return -1;
}


/**
  * @功能：  接收安卓机的应答包，并对接收结果进行处理
  * @参数：  命令参数（按键的按键码）
  * @返回值：无
  */
void doRcvResponResutl(u8 i)
{
	int reSendtimes = 0;		//数据重传标识
	int rcvValue;
	int j;
	while(reSendtimes<2)			
	{
		delay_ms(100);
		rcvValue = checkRcvPackageFcn();
		if(rcvValue == 1)		//安卓机接收到正确的数据包
		{
			//printf("host revceive package successful\r\n");	
			break;
		}
		else if(rcvValue == 0)		//安卓机接收到错误的数据包
		{
			//printf("host revceive package error\r\n");
			break;
		}
		else						//安卓机没有接收到数据包，或者安卓机发送的数据包出现错误
		{
			if(i<0xaa)				//传递的命令码如果小于0xaa，则在此处进行按键值的重传
				keyPackageTxFun(i);		//进行数据的重新传送
			else
				infraredPackageTxFun(i);	//否则的话重新传送的是红外光栅模块的数据包
		}
		reSendtimes++;
	}
	for(j=0;j<packageRcvSta;j++)
		packageRcvTemp[j]=0;	//对接收到的数据包进行置零操作
}









